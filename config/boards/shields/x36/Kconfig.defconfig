## config/boards/shields/x36/Kconfig.defconfig
```kconfig
# Copyright (c) 2020 The ZMK Contributors
# SPDX-License-Identifier: MIT

if SHIELD_x36

config ZMK_KEYBOARD_NAME
    default "x36"

endif
```
